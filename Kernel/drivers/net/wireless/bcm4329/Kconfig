## Kernel/drivers/net/wireless/bcm4329/Kconfig
```kconfig
config BCM4329
	tristate "Broadcom 4329 wireless cards support"
	depends on MMC
	select WIRELESS_EXT
	select WEXT_PRIV
	---help---
	  This module adds support for wireless adapters based on
	  Broadcom 4329 chipset.

	  This driver uses the kernel's wireless extensions subsystem.

	  If you choose to build a module, it'll be called dhd. Say M if
	  unsure.

config BCM4329_FW_PATH
	depends on BCM4329
	string "Firmware path"
	default "/system/etc/firmware/fw_bcm4329.bin"
	---help---
	  Path to the firmware file.

config BCM4329_NVRAM_PATH
	depends on BCM4329
	string "NVRAM path"
	default "/proc/calibration"
	---help---
	  Path to the calibration file.

config BROADCOM_WIFI
	default m
	tristate "Broadcom WiFi Driver"
	---help---
		Select this option to build Broadcom wlan driver
config BROADCOM_WIFI_VICTORY
	bool "Broadcom WiFi Driver for victory"
	depends on BROADCOM_WIFI
config BROADCOM_WIFI_ATLAS
	bool "Broadcom WiFi Driver for atlas"
	depends on BROADCOM_WIFI

config BROADCOM_WIFI_RESERVED_MEM
    bool "Samsung Multimedia Devices"
    depends on BROADCOM_WIFI
    default n
    ---help---
      This is a configuration for broadcom WLAN driver.

if BROADCOM_WIFI_RESERVED_MEM
config WLAN_SAMSUNG_MEMSIZE_BCM
    int "Memory size in kbytes for WLAN driver"
    default "256"
endif
```

## Kernel/kernel/Kconfig.nubernel.debug
```kconfig
menuconfig DEBUG_NUBERNEL
	bool "Custom debugging in the Nubernel kernel"
	depends on DEBUG_KERNEL
	default n
	help
	 This enables the custom debugging available in the Nubernel
	 kernel.

config DEBUG_NUBERNEL_CHRG
	bool "Battery charging debugging"
	depends on DEBUG_NUBERNEL
	default n
	help
	 This enables the custom battery charging debugging available
	 in the Nubernel kernel.

config DEBUG_NUBERNEL_FREQ
	bool "CPUfreq debugging"
	depends on DEBUG_NUBERNEL
	default n
	help
	 This enables the custom cpufreq debugging available in the
	 Nubernel kernel.

config DEBUG_NUBERNEL_GOV
	bool "Governor debugging"
	depends on DEBUG_NUBERNEL
	default n
	help
	 This enables the custom cpu governor debugging available in
	 the Nubernel kernel.

config DEBUG_NUBERNEL_PM
	bool "Power management debugging"
	depends on DEBUG_NUBERNEL
	default n
	help
	 This enables the custom power management debugging available in
	 the Nubernel kernel.

config DEBUG_NUBERNEL_NO_CONSOLE_SUSPEND
	bool "No console suspend"
	depends on DEBUG_NUBERNEL
	default n
	help
	 This disables the calls to suspend_console and resume_console
	 in the "suspend_devices_and_enter" function of kernel/power/suspend.c.
	 This seems to be the best way to get suspend/resume debugging info.
```
